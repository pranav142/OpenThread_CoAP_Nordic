## CoAP_Client/build_dongle/Kconfig/Kconfig.shield
```kconfig
osource "c:/Users/pknad/OneDrive/Desktop/Thread/coprocessor/boards/shields/*/Kconfig.shield"
osource "C:/ncs/v2.1.0/nrf/boards/shields/*/Kconfig.shield"
```

## CoAP_Client/build_dongle/Kconfig/Kconfig.shield.defconfig
```kconfig
osource "c:/Users/pknad/OneDrive/Desktop/Thread/coprocessor/boards/shields/*/Kconfig.defconfig"
osource "C:/ncs/v2.1.0/nrf/boards/shields/*/Kconfig.defconfig"
```
